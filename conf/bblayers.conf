## conf/bblayers.conf
```bitbake
# POKY_BBLAYERS_CONF_VERSION is increased each time build/conf/bblayers.conf
# changes incompatibly
POKY_BBLAYERS_CONF_VERSION = "2"

BBPATH = "${TOPDIR}"
BBFILES ?= ""

BBLAYERS ?= " \
  /home/alex-m/wrk/myproj/xilinx/yocto/poky/meta \
  /home/alex-m/wrk/myproj/xilinx/yocto/poky/meta-poky \
  /home/alex-m/wrk/myproj/xilinx/yocto/poky/meta-yocto-bsp \
  /home/alex-m/wrk/myproj/xilinx/yocto/meta-openembedded/meta-oe \
  /home/alex-m/wrk/myproj/xilinx/yocto/meta-arm/meta-arm-toolchain \
  /home/alex-m/wrk/myproj/xilinx/yocto/meta-arm/meta-arm \
  /home/alex-m/wrk/myproj/xilinx/yocto/meta-xilinx/meta-xilinx-core \
  /home/alex-m/wrk/myproj/xilinx/yocto/meta-xilinx/meta-xilinx-bsp \
  /home/alex-m/wrk/myproj/xilinx/yocto/meta-xilinx/meta-xilinx-vendor \
  /home/alex-m/wrk/myproj/xilinx/yocto/meta-custom \
  "
```

## meta-zturn-bsp/conf/layer.conf
```bitbake
BBPATH .= ":${LAYERDIR}"

BBFILES += "${LAYERDIR}/recipes-*/*/*.bb \
            ${LAYERDIR}/recipes-*/*/*.bbappend"

BBFILE_COLLECTIONS += "zturn-bsp"
BBFILE_PATTERN_zturn-bsp = "^${LAYERDIR}/"
BBFILE_PRIORITY_zturn-bsp = "6"

LAYERDEPENDS_zturn-bsp = "core xilinx"
LAYERSERIES_COMPAT_zturn-bsp = "scarthgap styhead walnascar"
```

## meta-zturn-bsp/conf/machine/zturn-zynq7.conf
```bitbake
#@TYPE: Machine
#@NAME: zturn-zynq7
#@DESCRIPTION: Machine support for MYIR Z-Turn (Zynq-7000) with custom HDMI PL

require conf/machine/zynq-generic.conf

# Используем ваш внешний Device Tree
KERNEL_DEVICETREE = ""
PREFERRED_PROVIDER_virtual/dtb = "device-tree"

# Провайдеры внешнего FSBL и Bitstream
PREFERRED_PROVIDER_virtual/fsbl = "fsbl"
PREFERRED_PROVIDER_fsbl = "fsbl"
PREFERRED_PROVIDER_virtual/bitstream = "bitstream-zturn"

# Конфигурация U-Boot для Z-Turn
UBOOT_MACHINE = "xilinx_zynq_virt_defconfig"

# Генерируем BOOT.BIN через xilinx-bootbin
SPL_BINARY = ""
EXTRA_IMAGEDEPENDS += "xilinx-bootbin"

BIF_COMMON_ATTR = ""
BIF_PARTITION_ATTR = "fsbl bitstream u-boot-xlnx"

BIF_PARTITION_ATTR[fsbl] = "bootloader"
BIF_PARTITION_IMAGE[fsbl] = "${DEPLOY_DIR_IMAGE}/fsbl-${MACHINE}.elf"
BIF_PARTITION_DEPENDS[fsbl] = "fsbl:do_deploy"

BIF_PARTITION_ATTR[bitstream] = ""
BIF_PARTITION_IMAGE[bitstream] = "${DEPLOY_DIR_IMAGE}/bitstream-${MACHINE}.bit"
BIF_PARTITION_DEPENDS[bitstream] = "bitstream-zturn:do_deploy"

BIF_PARTITION_ATTR[u-boot-xlnx] = ""
BIF_PARTITION_IMAGE[u-boot-xlnx] = "${DEPLOY_DIR_IMAGE}/u-boot.elf"
BIF_PARTITION_DEPENDS[u-boot-xlnx] = "virtual/bootloader:do_deploy"

# Файлы для раздела BOOT на SD-карте
IMAGE_BOOT_FILES = " \
    boot.bin \
    zynq-zturn.dtb \
    boot.scr \
"
CONFIG_DTFILE = "${LAYERDIR}/recipes-bsp/device-tree/files/zynq-zturn.dts"
```

## zturn_build/conf/bblayers.conf
```bitbake
# POKY_BBLAYERS_CONF_VERSION is increased each time build/conf/bblayers.conf
# changes incompatibly
POKY_BBLAYERS_CONF_VERSION = "2"

BBPATH = "${TOPDIR}"
BBFILES ?= ""

BBLAYERS ?= " \
  /home/alex-m/wrk/myproj/xilinx/zturn_yocto/poky/meta \
  /home/alex-m/wrk/myproj/xilinx/zturn_yocto/poky/meta-poky \
  /home/alex-m/wrk/myproj/xilinx/zturn_yocto/poky/meta-yocto-bsp \
  /home/alex-m/wrk/myproj/xilinx/zturn_yocto/meta-openembedded/meta-oe \
  /home/alex-m/wrk/myproj/xilinx/zturn_yocto/meta-arm/meta-arm-toolchain \
  /home/alex-m/wrk/myproj/xilinx/zturn_yocto/meta-arm/meta-arm \
  /home/alex-m/wrk/myproj/xilinx/zturn_yocto/meta-xilinx/meta-xilinx-core \
  /home/alex-m/wrk/myproj/xilinx/zturn_yocto/meta-xilinx/meta-xilinx-bsp \
  /home/alex-m/wrk/myproj/xilinx/zturn_yocto/meta-xilinx/meta-xilinx-vendor \
  /home/alex-m/wrk/myproj/xilinx/zturn_yocto/meta-zturn-bsp \
  "
```
